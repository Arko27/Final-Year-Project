//Including all the Library Modules
#include <ESP8266WiFi.h>
#include <BlynkSimpleEsp8266.h>
#include <dht11.h>

// Defining the Blynk Credentials
#define BLYNK_TEMPLATE_ID "TMPLpeOLYUhZ"
#define BLYNK_DEVICE_NAME "Factory Monitoring and Alert System"
#define BLYNK_AUTH_TOKEN "UBnj8JUp8M7UQcZfG9y6xPy0Ytui1l65"
#define BLYNK_PRINT Serial

char auth[] = "UBnj8JUp8M7UQcZfG9y6xPy0Ytui1l65"; // Authorization Token
char ssid[] = "Arko wishnet";                    // Enter your Wifi Username
char pass[] = "arko@2020";                      // Enter your Wifi password

// Defining the Analog and Digital pins used in this Project
#define echoPin D0
#define trigPin D1
#define DHT11PIN D2
#define fire_pin D3
#define gas_pin A0
dht11 DHT11;

float dist, duration, temp, humid;
int gas_data, fire_data=1;

WidgetLED led(V4);
BlynkTimer timer;

// This function is triggered to send the datas to the Blynk Platform
void myTimer()
{
  Blynk.virtualWrite(V0, dist);
  Blynk.virtualWrite(V1, gas_data);
  Blynk.virtualWrite(V2, temp);
  Blynk.virtualWrite(V3, humid);
}

// This setup() function is run only at the beginning of the execution of the program
void setup()
{
  Serial.begin(115200);
  pinMode(trigPin, OUTPUT);
  pinMode(echoPin, INPUT);
  pinMode(gas_data, INPUT);
  pinMode(fire_pin, INPUT);
  
  Blynk.begin(auth, ssid, pass);
  timer.setInterval(2000L, myTimer);
}

// This loop() function is run after every regular interval as long as the device is on
void loop()
{

// DISTANCE DATA
  
  //Here a pulse is being generated by the Ultrasonic Sensor to calculate the distance of the nearest obstacle
  digitalWrite(trigPin, LOW);
  delay(2);
  digitalWrite(trigPin, HIGH);
  delay(10);
  digitalWrite(trigPin, LOW);

  duration = pulseIn(echoPin, HIGH);
  dist = duration *0.035/2;

  Serial.println("Distance : " + (String)dist);

// An event is being triggered as soon as the distance value crosses its threshold
  if(dist < 5)
    Blynk.logEvent("alert", "A Person very close to the Obstacle has been detected!!!");

// GAS DATA

  gas_data = analogRead(gas_pin);
  Serial.println("Gas Value : " + (String)gas_data);

// An event is being triggered as soon as the Gas Sensor detects any presence of inflammable gas 
  if(gas_data > 500)
    Blynk.logEvent("alert", "Presence of Flammable Gas has been detected!!!");
  

// TEMPERATURE AND HUMIDITY DATA
   int chk = DHT11.read(DHT11PIN);

  temp = (float)DHT11.temperature;
  Serial.println("Temperature: " + (String)temp);
  
// An event is being triggered as soon as the Temperature Value crosses its threshold
  if(temp > 50)
    Blynk.logEvent("alert", "The Temperature of the Surrounding has increased suddenly!!!");
  

  humid = (float)DHT11.humidity;
  Serial.println("Humidity: " + (String)humid);

// An event is being triggered as soon as the Humidity Value crosses its threshold
  if(humid > 90)
    Blynk.logEvent("alert", "The Humidity of the Surrounding has increased suddenly!!!");  


// FIRE ALERT
  fire_data = digitalRead(fire_pin);
  Serial.println("Fire Detected :" + (String)fire_data);

  // Fire is detected so the LED changes to RED
  if(fire_data == 0)
  {
    Blynk.setProperty(V4,"color","#D3435C");
    led.on();
  }

  // Fire is not detected so the LED changes to GREEN
  else if(fire_data == 1)
  {
    Blynk.setProperty(V4,"color","#23C48E");
    led.on();
  }
  
  Blynk.run(); 
  timer.run();
}
